## board/flir/ec101/Kconfig
```kconfig
if TARGET_EC101

config SYS_BOARD
	default "ec101"

config SYS_VENDOR
	default "flir"

config SYS_SOC
	default "mx6"

config SYS_CONFIG_NAME
	default "ec101"

endif
```

## board/flir/ec201/Kconfig
```kconfig
if TARGET_MX7ULP_EC201

config SYS_BOARD
	default "ec201"

config SYS_VENDOR
	default "flir"

config SYS_CONFIG_NAME
	default "ec201"

endif
```

## board/flir/ec302/Kconfig
```kconfig
if TARGET_MX7ULP_EC302

config SYS_BOARD
	default "ec302"

config SYS_VENDOR
	default "flir"

config SYS_CONFIG_NAME
	default "ec302"

endif
```

## board/flir/ec401w/Kconfig
```kconfig
if TARGET_MX7ULP_EC401W

config SYS_BOARD
	default "ec401w"

config SYS_VENDOR
	default "flir"

config SYS_CONFIG_NAME
	default "ec401w"

source "board/flir/common/Kconfig"

endif
```

## board/flir/eoco/Kconfig
```kconfig
if TARGET_EOCO

config SYS_BOARD
	default "eoco"
config SYS_VENDOR
	default "flir"

config SYS_CONFIG_NAME
	default "eoco"

config SYS_TEXT_BASE
    default 0x17800000

endif
```

## board/flir/mx6ec101/Kconfig
```kconfig
if TARGET_MX6EC101

config SYS_BOARD
	default "mx6ec101"

config SYS_VENDOR
	default "flir"

config SYS_CONFIG_NAME
	default "mx6ec101"

config SYS_TEXT_BASE
    default 0x17800000

endif
```

## board/flir/mx6ec701/Kconfig
```kconfig
if TARGET_MX6EC701

config SYS_BOARD
	default "mx6ec701"

config SYS_VENDOR
	default "flir"

config SYS_CONFIG_NAME
	default "mx6ec701"

config SYS_TEXT_BASE
    default 0x17800000

source "board/flir/common/Kconfig"
endif
```

## configs/ec101_defconfig
```kconfig
#CONFIG_SYS_EXTRA_OPTIONS="IMX_CONFIG=board/flir/ec101/ec101.cfg,MX6S,DDR_MB=512"
CONFIG_SYS_EXTRA_OPTIONS="IMX_CONFIG=board/flir/ec101/ec101.cfg,DDR_MB=512"
CONFIG_ARM=y
CONFIG_ARCH_MX6=y
CONFIG_MX6S=y
CONFIG_TARGET_EC101=y
CONFIG_SYS_TEXT_BASE=0x17800000
CONFIG_SYS_MALLOC_F=y
CONFIG_SYS_MALLOC_F_LEN=0x400

CONFIG_DISPLAY_CPUINFO=y
CONFIG_DISPLAY_BOARDINFO_LATE=y

CONFIG_SYS_L2CACHE_OFF=y

CONFIG_BOARD_EARLY_INIT_F=y
CONFIG_BOARD_LATE_INIT=y

CONFIG_MXC_GPIO=y
CONFIG_MXC_UART=y

# MMC Configs #
CONFIG_FSL_ESDHC=y
CONFIG_FSL_USDHC=y
#CONFIG_SYS_FSL_ESDHC_ADDR      0
CONFIG_MMC=y
CONFIG_CMD_MMC=y
#define CONFIG_GENERIC_MMC
#define CONFIG_CMD_EMMC
CONFIG_BOUNCE_BUFFER=y
CONFIG_CMD_EXT2=y
CONFIG_CMD_EXT4=y
CONFIG_CMD_FAT=y
CONFIG_FAT_WRITE=y
CONFIG_DOS_PARTITION=y
CONFIG_EFI_PARTITION=y
CONFIG_CMD_GPT=y
CONFIG_PARTITION_UUIDS=y
CONFIG_CMD_PART=y

# Ethernet config #
CONFIG_CMD_PING=y
CONFIG_CMD_DHCP=y
CONFIG_CMD_MII=y
CONFIG_CMD_NET=y
CONFIG_FEC_MXC=y
CONFIG_MII=y
#define IMX_FEC_BASE			ENET_BASE_ADDR
#define CONFIG_ETHPRIME			"FEC"
CONFIG_PHYLIB=y
#define CONFIG_ARP_TIMEOUT     200UL
CONFIG_PHY_MICREL=y
#CONFIG_ENET_PHYADDR_MICREL=0
#define CONFIG_FEC_MXC_PHYADDR CONFIG_ENET_PHYADDR_MICREL
#define CONFIG_FEC_XCV_TYPE             RMII

CONFIG_CONS_INDEX=1
CONFIG_BAUDRATE=115200

CONFIG_CMD_BMODE=y
CONFIG_CMD_BOOTZ=y
CONFIG_CMD_IMLS=n
CONFIG_CMD_SETEXPR=y
CONFIG_CMD_FUSE=y
CONFIG_MXC_OCOTP=y


CONFIG_CMD_GPIO=y
CONFIG_CMD_SOURCE=y
CONFIG_CMD_TIME=y

CONFIG_SYS_TEXT_BASE=0x17800000

CONFIG_SYS_LONGHELP=y
CONFIG_HUSH_PARSER=y
CONFIG_SYS_PROMPT_HUSH_PS2="> "
CONFIG_AUTO_COMPLETE=y

CONFIG_MEMTEST=y
CONFIG_SYS_MEMTEST_START=0x10000000
CONFIG_SYS_MEMTEST_END=0x10010000
CONFIG_SYS_HZ=1000

CONFIG_SILENT_CONSOLE=y

# Physical Memory Map #
CONFIG_NR_DRAM_BANKS=1
#define PHYS_SDRAM                     MMDC0_ARB_BASE_ADDR
#define CONFIG_SYS_SDRAM_BASE          PHYS_SDRAM
#define CONFIG_SYS_INIT_RAM_ADDR       IRAM_BASE_ADDR
#define CONFIG_SYS_INIT_RAM_SIZE       IRAM_SIZE


CONFIG_DM=y
CONFIG_DM_THERMAL=y

CONFIG_SYS_MAXARGS=256
CONFIG_NR_DRAM_BANKS=1
CONFIG_ENV_SIZE=0x4000
CONFIG_BOOTDELAY=0
#CONFIG_DDR_MB=512


CONFIG_CMD_SF=y
CONFIG_CMD_SPI=y
CONFIG_SPI=y
CONFIG_SPI_FLASH=y
CONFIG_SPI_FLASH_STMICRO=y
CONFIG_SPI_FLASH_BAR=y
CONFIG_MXC_SPI=y
CONFIG_SF_DEFAULT_BUS=0
CONFIG_SF_DEFAULT_SPEED=20000000
CONFIG_SF_DEFAULT_MODE=0
CONFIG_SF_DEFAULT_CS=156
```

## configs/flir_eoco_defconfig
```kconfig
CONFIG_ARM=y
CONFIG_ARCH_MX6=y
CONFIG_NR_DRAM_BANKS=1
CONFIG_ENV_SIZE=0x4000
CONFIG_ENV_OFFSET=0x1C0000
CONFIG_MX6QP=y
CONFIG_TARGET_EOCO=y
CONFIG_FLIR_EEPROM=y
CONFIG_FLIR_DA9063=y
CONFIG_FLIR_COMMAND_KBD=y
CONFIG_FLIR_COMMAND_RECOVERYKEY=y
CONFIG_FLIR_COMMAND_KBDSECRET=y
CONFIG_FLIR_COMMAND_CHECKCHARGER=y
CONFIG_FLIR_COMMAND_LOADFPGA=y
CONFIG_FLIR_USBCHARGE=y
CONFIG_CMD_BOARD=y
CONFIG_DM_GPIO=y
CONFIG_ENV_OFFSET_REDUND=0x1E0000
CONFIG_DEFAULT_DEVICE_TREE="imx6dp-eoco"
CONFIG_FLIR_PLATFORM_EOCO=y
CONFIG_SUPPORT_RAW_INITRD=y
CONFIG_OF_BOARD_SETUP=y
CONFIG_SYS_EXTRA_OPTIONS="IMX_CONFIG=board/flir/eoco/eoco.cfg"
CONFIG_BOOTDELAY=3
# CONFIG_CONSOLE_MUX is not set
CONFIG_SYS_CONSOLE_IS_IN_ENV=y
CONFIG_SYS_CONSOLE_OVERWRITE_ROUTINE=y
CONFIG_HUSH_PARSER=y
CONFIG_CMD_BOOTZ=y
CONFIG_CMD_MEMTEST=y
CONFIG_CMD_GPIO=y
CONFIG_CMD_GPT=y
CONFIG_CMD_I2C=y
CONFIG_CMD_MMC=y
CONFIG_CMD_PART=y
CONFIG_CMD_PCI=y
CONFIG_CMD_SF=y
CONFIG_CMD_SPI=y
CONFIG_CMD_DHCP=y
CONFIG_CMD_MII=y
CONFIG_CMD_PING=y
CONFIG_CMD_BMP=y
CONFIG_CMD_CACHE=y
CONFIG_CMD_EXT2=y
CONFIG_CMD_EXT4=y
CONFIG_CMD_EXT4_WRITE=y
CONFIG_CMD_FAT=y
CONFIG_CMD_FS_GENERIC=y
CONFIG_OF_CONTROL=y
CONFIG_OF_EMBED=y
CONFIG_ENV_IS_IN_MMC=y
CONFIG_SYS_REDUNDAND_ENVIRONMENT=y
CONFIG_REGMAP=y
CONFIG_SYSCON=y
CONFIG_BOUNCE_BUFFER=y
CONFIG_FPGA_ALTERA=y
# CONFIG_FPGA_XILINX is not set
CONFIG_CMD_PCA953X=y
CONFIG_DM_PCA953X=y
CONFIG_DM_I2C=y
CONFIG_I2C_SET_DEFAULT_BUS_NUM=y
CONFIG_I2C_DEFAULT_BUS_NUMBER=0x02
CONFIG_SYS_I2C_MXC=y
CONFIG_DM_MMC=y
CONFIG_FSL_USDHC=y
CONFIG_MTD=y
CONFIG_DM_MTD=y
CONFIG_SPI_FLASH=y
CONFIG_SF_DEFAULT_MODE=0
CONFIG_SF_DEFAULT_SPEED=20000000
CONFIG_SPI_FLASH_STMICRO=y
CONFIG_SPI_FLASH_MTD=y
CONFIG_PHYLIB=y
CONFIG_PHY_MICREL=y
CONFIG_PHY_MICREL_KSZ8XXX=y
CONFIG_DM_ETH=y
CONFIG_MII=y
CONFIG_PCI=y
CONFIG_DM_PCI=y
CONFIG_PINCTRL=y
CONFIG_PINCTRL_IMX6=y
CONFIG_MXC_UART=y
CONFIG_SPI=y
CONFIG_MXC_SPI=y
CONFIG_DM_VIDEO=y
# CONFIG_VIDEO_BPP8 is not set
# CONFIG_VIDEO_BPP32 is not set
CONFIG_SYS_WHITE_ON_BLACK=y
CONFIG_VIDEO_LCD_ST7703=y
CONFIG_VIDEO_LCD_ST7703_ROTATE_180=y
CONFIG_VIDEO_IPUV3=y
CONFIG_SPLASH_SCREEN=y
CONFIG_SPLASH_SCREEN_ALIGN=y
CONFIG_VIDEO_BMP_GZIP=y
```

## configs/mx7ulp_ec201_defconfig
```kconfig
CONFIG_ARM=y
CONFIG_ARCH_MX7ULP=y
CONFIG_SYS_TEXT_BASE=0x67800000
CONFIG_NR_DRAM_BANKS=1
CONFIG_ENV_SIZE=0x4000
CONFIG_ENV_OFFSET=0x1C0000
CONFIG_FLIR_EEPROM=y
CONFIG_FLIR_PF1550=y
CONFIG_FLIR_USBDCD=y
CONFIG_FLIR_LC709203=y
CONFIG_FLIR_DISPLAY_UTILS=y
CONFIG_CMD_UPDATE_FDT_EEPROM=y
CONFIG_CMD_BOARD=y
CONFIG_FLIR_SET_MAC=y
CONFIG_FLIR_CHARGEAPP=y
CONFIG_FLIR_RECOVERY_TRIGGER=y
CONFIG_FLIR_BOOTSTATE=y
CONFIG_DM_GPIO=y
CONFIG_TARGET_MX7ULP_EC201=y
CONFIG_ENV_OFFSET_REDUND=0x1E0000
CONFIG_IMX_BOOTAUX=y
CONFIG_DEFAULT_DEVICE_TREE="imx7ulp-ec201"
CONFIG_SYS_EXTRA_OPTIONS="IMX_CONFIG=board/flir/ec201/imximage.cfg"
CONFIG_BOOTDELAY=0
CONFIG_DEFAULT_FDT_FILE="imx7ulp-ec201.dtb"
# CONFIG_SYS_DEVICE_NULLDEV is not set
CONFIG_BOARD_EARLY_INIT_F=y
CONFIG_HUSH_PARSER=y
CONFIG_CMD_BOOTZ=y
CONFIG_CMD_GPIO=y
CONFIG_CMD_GPT=y
CONFIG_CMD_I2C=y
CONFIG_CMD_MMC=y
CONFIG_CMD_DHCP=y
CONFIG_CMD_PING=y
CONFIG_CMD_BMP=y
CONFIG_CMD_EXT4=y
CONFIG_CMD_FAT=y
CONFIG_OF_CONTROL=y
CONFIG_ENV_IS_IN_MMC=y
CONFIG_SYS_REDUNDAND_ENVIRONMENT=y
CONFIG_DM=y
CONFIG_REGMAP=y
CONFIG_SYSCON=y
CONFIG_IMX_RGPIO2P=y
# CONFIG_MXC_GPIO is not set
CONFIG_DM_I2C=y
CONFIG_SYS_I2C_IMX_LPI2C=y
CONFIG_DM_MMC=y
CONFIG_FSL_USDHC=y
CONFIG_PINCTRL=y
CONFIG_PINCTRL_IMX7ULP=y
CONFIG_DM_REGULATOR=y
CONFIG_DM_REGULATOR_FIXED=y
CONFIG_DM_REGULATOR_GPIO=y
CONFIG_DM_SERIAL=y
CONFIG_FSL_LPUART=y
CONFIG_DM_VIDEO=y
CONFIG_BACKLIGHT_GPIO=y
CONFIG_VIDEO_LCD_HIMAX_HX8394=y
CONFIG_VIDEO_IMX_NW_DSI=y
CONFIG_LCD=y
CONFIG_SPLASH_SCREEN=y
CONFIG_SPLASHIMAGE_GUARD=y
CONFIG_SPLASH_SCREEN_ALIGN=y
CONFIG_SPLASH_SOURCE=y
CONFIG_VIDEO_BMP_GZIP=y
CONFIG_BMP_24BPP=y
CONFIG_ULP_WATCHDOG=y
```

## configs/mx7ulp_ec401w_defconfig
```kconfig
CONFIG_ARM=y
CONFIG_ARCH_MX7ULP=y
CONFIG_SYS_TEXT_BASE=0x67800000
CONFIG_NR_DRAM_BANKS=1
CONFIG_ENV_SIZE=0x4000
CONFIG_ENV_OFFSET=0x1C0000
CONFIG_FLIR_EEPROM=y
CONFIG_FLIR_PF1550=y
CONFIG_FLIR_USBDCD=y
CONFIG_FLIR_LC709203=y
CONFIG_FLIR_LED_UTILS=y
CONFIG_CMD_UPDATE_FDT_EEPROM=y
CONFIG_CMD_BOARD=y
CONFIG_FLIR_SET_MAC=y
CONFIG_FLIR_CHARGEAPP=y
CONFIG_FLIR_RECOVERY_TRIGGER=y
CONFIG_FLIR_BOOTSTATE=y
CONFIG_DM_GPIO=y
CONFIG_TARGET_MX7ULP_EC401W=y
CONFIG_ENV_OFFSET_REDUND=0x1E0000
CONFIG_IMX_BOOTAUX=y
CONFIG_DEFAULT_DEVICE_TREE="imx7ulp-ec401w"
CONFIG_FLIR_PLATFORM_EC401W=y
CONFIG_SYS_EXTRA_OPTIONS="IMX_CONFIG=board/flir/ec401w/imximage.cfg"
CONFIG_BOOTDELAY=0
CONFIG_DEFAULT_FDT_FILE="imx7ulp-ec401w.dtb"
CONFIG_BOARD_EARLY_INIT_F=y
CONFIG_HUSH_PARSER=y
CONFIG_CMD_BOOTZ=y
CONFIG_CMD_GPIO=y
CONFIG_CMD_GPT=y
CONFIG_CMD_I2C=y
CONFIG_CMD_MMC=y
CONFIG_CMD_DHCP=y
CONFIG_CMD_PING=y
CONFIG_CMD_EXT4=y
CONFIG_CMD_FAT=y
CONFIG_OF_CONTROL=y
CONFIG_ENV_IS_IN_MMC=y
CONFIG_SYS_REDUNDAND_ENVIRONMENT=y
CONFIG_DM=y
CONFIG_IMX_RGPIO2P=y
# CONFIG_MXC_GPIO is not set
CONFIG_DM_I2C=y
CONFIG_SYS_I2C_IMX_LPI2C=y
CONFIG_LED=y
CONFIG_LED_LP5562=y
CONFIG_LED_BLINK=y
CONFIG_LED_GPIO=y
CONFIG_DM_MMC=y
CONFIG_FSL_USDHC=y
CONFIG_PINCTRL=y
CONFIG_PINCTRL_IMX7ULP=y
CONFIG_DM_REGULATOR=y
CONFIG_DM_REGULATOR_FIXED=y
CONFIG_DM_REGULATOR_GPIO=y
CONFIG_DM_SERIAL=y
CONFIG_FSL_LPUART=y
CONFIG_ULP_WATCHDOG=y
```

## flir/Kconfig
```kconfig
menu FLIR

menu FLIR_PLATFORM_SELECTION
config FLIR_PLATFORM
       bool "Select flir platform model"
       default n

config FLIR_PLATFORM_EOCO
       bool "EOCO Specific platform selection"
       default n
       help
		EOCO Platforms differs some from the FLIR_PLATFORM model
		pins for FPGA configuration amooung other has been changed
endmenu

config FLIR_COMMANDS
       bool "Support generic flir commands"
       default y
       help
	"support flir commands"

config FLIR_OLD_COMMAND_STYLE
       bool "Support flir old command style"
       default y
       help
	"Support old-style FLIR commands (without flir_)"

source "flir/src/Kconfig"


##//Not a good practice...
##https://developer.nordicsemi.com/nRF_Connect_SDK/doc/latest/zephyr/guides/build/kconfig/tips.html

config FLIR_FPGA
       bool "Support FPGA"
       default y

if FLIR_FPGA

config FPGA_XILINX
       bool "Support XILINX FPGA"
       default y
       help 
       	    "XILINX FPGA"

config FPGA_ALTERA
       bool "Support ALTERA FPGA"
       default n
       help 
       	    "ALTERA FPGA"

endif

endmenu
```

## flir/src/Kconfig
```kconfig
if FLIR_COMMANDS

config FLIR_COMMAND_RECOVERYKEY
       bool "FLIR_COMMAND_RECOVERYKEY"
       depends on FLIR_COMMANDS       
       depends on FLIR_COMMAND_KBD
       default n
       help
		FLIR Specific commands support"


config FLIR_COMMAND_KBDSECRET
       bool "FLIR_COMMAND_KBDSECRET"
       depends on FLIR_COMMANDS
       depends on FLIR_COMMAND_KBD
       default n
       help
		"FLIR_COMMAND_KBDSECRET"
config FLIR_COMMAND_KBD
       bool "FLIR_COMMAND_KBD"
       depends on FLIR_COMMANDS
       depends on CMD_I2C
       default n
       help
		"FLIR_COMMAND_KBD"
config FLIR_COMMAND_CHECKCHARGER
       bool "FLIR_COMMAND_CHECKCHARGER"
       depends on FLIR_COMMANDS
       depends on CMD_I2C
       default n
       help
		"FLIR_COMMAND_CHECKCHARGER"
config FLIR_COMMAND_LOADFPGA
       bool "FLIR_COMMAND_LOADFPGA"
       depends on FLIR_COMMANDS
       depends on CMD_SPI
       default n
       help
		"FLIR_COMMAND_LOADFPGA"
config FLIR_EEPROM
       bool "FLIR_EEPROM"
       depends on FLIR_COMMANDS
       default n
       help
		"FLIR_EEPROM"
config FLIR_USBCHARGE
       bool "FLIR_USBCHARGE"
       depends on FLIR_COMMANDS
       depends on CMD_I2C
       default n
       help
		"FLIR_USBCHARGE"
config FLIR_SYS_EEPROM
       bool "FLIR_SYS_EEPROM"
       depends on FLIR_COMMANDS
       default n
       help
		"FLIR_SYS_EEPROM"
config FLIR_BOARD_SUPPORT
       bool "FLIR_BOARD_SUPPORT"
       depends on FLIR_COMMANDS
       default n
       help
		"FLIR_BOARD_SUPPORT"
config READMAINBOARDREVISION
       bool "READMAINBOARDREVISION"
       depends on FLIR_COMMANDS
       default n
       help
		"REDMAINBOARDREVISION"
config CMD_UPDATE_FDT_EEPROM
       bool "CMD_UPDATE_FDT_EEPROM"
       depends on FLIR_COMMANDS
       default n
       help
		"CMD_UPDATE_FDT_EEPROM"
config CMD_BOARD
       bool "CMD_BOARD"
       depends on FLIR_COMMANDS
       depends on CMD_I2C
       default n
       help
		"CMD_BOARD"
config FLIR_DA9063
       bool "Support FLIR DA9063"
       depends on MXC_SPI
       depends on MX6
       default n
       help
		"FLIR_DA9063"


endif 
```
