## board/flir/common/Kconfig
```kconfig
config FLIR_EEPROM
	bool "EEPROM commons"
	default n
	help
	  Common code for system EEPROM access
	  Requires: DM_I2C

config FLIR_DA9063
	bool "DA9063 PMIC"
	depends on MXC_SPI
	depends on MX6
	default n
	help
	  Command 'pmic', for accessing DA9063 PMIC registers

config FLIR_PF1550
	bool "PF1550 PMIC"
	default n
	help
	  Common code interface for PF1550 PMIC.

config FLIR_USBDCD
	bool "USBDCD"
	depends on FLIR_PF1550
	default n
	help
	  Common code interface for USB-DCD negotiation.

config FLIR_LC709203
	bool "LC709203"
	default n
	help
	  Common code interface for LC709203 fuelgauge.

config FLIR_DISPLAY_UTILS
	bool "Display utils"
	default n
	help
	  Common code interface for display interaction.

config FLIR_LED_UTILS
	bool "LED utils"
	default n
	help
	  Common code interface for LED interaction.

config FLIR_ORIG_FORMAT_SERIAL_MX6
	bool "Serial in high-low format"
	depends on ARCH_MX6
	default n
	help
	  Serial in high-low format for backwards compatibility.
	  Use in products, which have been previously released 
	  with the serial in high-low format. Those will need to
	  keep the same format after the u-boot upgrade.

config FLIR_BOARD_SUPPORT
	bool "IO Board support"
	default n
	help
	  Common functions for supplying camera-specific hardware settings

config FLIR_COMMANDS
	bool "Common FLIR commands"
	default y
	help
	  Support FLIR-specific commands

config FLIR_OLD_COMMAND_STYLE
	bool "Old command style"
	depends on FLIR_COMMANDS
	default y
	help
	  Support old-style FLIR commands (without flir_)

config FLIR_COMMAND_KBD
	bool "Keyboard support (flir_kbd)"
	depends on FLIR_COMMANDS
	depends on CMD_I2C
	default n
	help
	  GPIO-expander keyboard functionality, as well as a test
	  command 'flir_kbd'.

config FLIR_COMMAND_RECOVERYKEY
	bool "Recovery key command (recoverykey)"
	depends on FLIR_COMMANDS
	depends on FLIR_COMMAND_KBD
	default n
	help
	  Command 'recoverykey' that detects whether a designated
	  trigger key is pressed. Returns a true value in the Hush shell
	  if it is pressed and false otherwise.

config FLIR_RECOVERYKEY_VALUE
	string "Recovery-key value"
	depends on FLIR_COMMAND_RECOVERYKEY
	default "R"
	help
	  Device-tree label of the button-class device that causes the recoverykey
	  command to return true. Only single-character labels are supported in this
	  implementation.

config FLIR_SAFEBOOT_KEY_VALUE
	string "Safe-boot key value"
	depends on FLIR_COMMAND_RECOVERYKEY
	default "S"
	help
	  Device-tree label of a button-class device that overrides the recoverykey.
	  Motivation for the safeboot key is to provide a single-press method that forces
	  the kbd_secret command to return true.
	  The current version only supports single-character labels.

config FLIR_COMMAND_KBDSECRET
	bool "Recovery sequence command (kbd_secret)"
	depends on FLIR_COMMAND_RECOVERYKEY
	default n
	help
	  Command 'kbd_secret', for detecting keyboard sequences.
	  Returns a true value in the Hush shell if the defined key sequence
	  is pressed fast enough, otherwise false.
	  There is a 3s timeout for each keypress.
	  The command is intended for triggering recovery boot, and will
	  display FLIR-specific system info on available stdio device.

config FLIR_RECOVERY_SEQUENCE
	string "Recovery-boot sequence"
	depends on FLIR_COMMAND_KBDSECRET
	default "UD"
	help
	  Key sequence used by the kbd_secret command.
	  The string value corresponds to labels of button-class devices
	  in the device tree.
	  The current version only supports single-character labels.

config FLIR_COMMAND_CHECKCHARGER
	bool "Charger check (flir_checkcharger)"
	depends on FLIR_COMMANDS
	depends on CMD_I2C
	default n
	help
	  Command 'flir_checkcharger'. Examines charger status.

config FLIR_COMMAND_LOADFPGA
	bool "Load FPGA (flir_loadfpga)"
	depends on FLIR_COMMANDS
	depends on CMD_SPI
	default n
	help
	  Command 'flir_loadfpga' for loading FPGA from flash device.

config FLIR_BQ27XXX
	bool "BQ27xxx battery fuelgauge module"
	default n
	help
	  Texas Instruments Fuelgauge family BQ27
	  Supports BQ27520 and BQ27542

config FLIR_BQ27XXX_I2C_BUS
	int "Fuelgauge I2C bus"
	depends on FLIR_BQ27XXX
	default 3
	help
	  I2C bus ID for the system fuelgauge
	  Bus indexes start at zero

config FLIR_BQ27XXX_I2C_ADDR
	hex "Fuelgauge I2C address"
	depends on FLIR_BQ27XXX
	default 0xAA
	help
	  I2C chip address for the system fuelgauge
	  Address is given in 8-bit format

config FLIR_COMMAND_BQ27
	bool "BQ27xxx fuelgauge test command (bq27)"
	depends on FLIR_BQ27XXX
	default n
	help
	  Test command 'bq27' for TI BQ27xxx fuelgauges
	  Implements some commonly used bq27 commands

config FLIR_USBCHARGE
	bool "USB charger state (chargeState)"
	depends on FLIR_COMMANDS
	depends on CMD_I2C
	select FLIR_BQ27XXX
	default n
	help
	  Command 'chargeState' for controlling the USB charger state.
	  PMIC and fuelgauge information is combined, so the proper
	  decision on how to proceed can be made.

config FLIR_COMMAND_SHOWCHARGE
	bool "Charge visualizer (chargeapp)"
	depends on FLIR_COMMANDS
	depends on FLIR_USBCHARGE
	depends on ARCH_MX6
	default n
	help
	  Command 'chargeapp', in a version that does not manage charging.
	  Charger status and charge level is examined.

config FLIR_CHARGEAPP
	bool "Chargeapp"
	depends on FLIR_COMMANDS
	depends on !ARCH_MX6
	default n
	help
	  Command 'chargeapp', for charging in u-boot.

config FLIR_COMMAND_MAC
	bool "EEPROM MAC access (mac)"
	depends on FLIR_COMMANDS
	depends on FLIR_EEPROM
	default n
	help
	  Command 'mac', for reading/writing MAC stored in mainboard EEPROM
	  Note that only the NIC bytes are stored in EEPROM.
	  FLIR device ID (OUI) is always 00:40:7f

config READMAINBOARDREVISION
	bool "Mainboard revision (readmainboardrevision/article)"
	depends on FLIR_COMMANDS
	default n
	help
	  Commands 'readmainboardrevision' and 'readmainboardarticle'

config CMD_UPDATE_FDT_EEPROM
	bool "Update FDT EEPROM (update_fdt_eeprom)"
	depends on FLIR_COMMANDS
	default n
	help
	  Command 'update_fdt_eeprom'. Create an FDT node with EEPROM info.

config CMD_BOARD
	bool "Board info (flir_board)"
	depends on FLIR_COMMANDS
	depends on CMD_I2C
	default n
	help
	  Command 'flir_board', fills env vars with revision and article

config FLIR_SET_MAC
	bool "Set mac"
	depends on FLIR_COMMANDS
	default n
	help
	  Command 'setmac', for setting the mac address.

config FLIR_RECOVERY_TRIGGER
	bool "Recovery trigger"
	depends on FLIR_COMMANDS
	default n
	help
	  Command 'recoverytrigger', for running recovery sequence.

config FLIR_BOOTSTATE
	bool "Bootstate"
	depends on FLIR_COMMANDS
	default n
	help
	  Command 'bootstate', for running booting sequence.

config FLIR_BOOTSPLASH
	bool "Bootplash"
	default n
	help
	  Adds common code for splash screen.
```

## board/flir/ec202/Kconfig
```kconfig
if TARGET_MX7ULP_EC202

config SYS_BOARD
	default "ec202"

config SYS_VENDOR
	default "flir"

config SYS_CONFIG_NAME
	default "ec202"

endif
```

## board/flir/ec702/Kconfig
```kconfig
if TARGET_EC702

config SYS_BOARD
	default "ec702"

config SYS_VENDOR
	default "flir"

config SYS_CONFIG_NAME
	default "ec702"

config SYS_TEXT_BASE
	default 0x17800000

endif
```
