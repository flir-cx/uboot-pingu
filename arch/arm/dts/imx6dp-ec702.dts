// SPDX-License-Identifier: GPL-2.0
/*
 * Copyright (C) 2024 FLIR Systems
 *
 * The code contained herein is licensed under the GNU General Public
 * License. You may obtain a copy of the GNU General Public License
 * Version 2 or later at the following locations:
 *
 * http://www.opensource.org/licenses/gpl-license.html
 * http://www.gnu.org/copyleft/gpl.html
 */

/dts-v1/;

#include "imx6qp.dtsi"
#include "imx6dp-ec702.dtsi"

/ {
	model = "FLIR i.MX6 Dual Plus ec702 board";
	compatible = "fsl,imx6dl-sabresd", "fsl,imx6dl";
};
